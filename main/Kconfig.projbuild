## main/Kconfig.projbuild
```kconfig
menu "ESP Thread Border Router Web"

    config OPENTHREAD_BR_START_WEB
        bool "Enable the official ESP Thread Border Router Web GUI and REST API"
        select OPENTHREAD_COMMISSIONER
        select OPENTHREAD_JOINER
        default y
        help
            Start Espressif's esp_ot_br_server after the W5500 Ethernet
            interface obtains an IP address.

endmenu

menu "Matter Accessory Identity"

    config MATTER_VENDOR_NAME
        string "Vendor name"
        default "Espressif"
        help
            Basic Information VendorName shown to Matter controllers.
            Matter limits this value to 32 characters.

    config MATTER_PRODUCT_NAME
        string "Product/model name"
        default "Thread Border Router"
        help
            Basic Information ProductName shown to Matter controllers.
            Matter limits this value to 32 characters.

    config MATTER_ACCESSORY_NAME
        string "Default accessory/node name"
        default "Thread Border Router"
        help
            Initial Basic Information NodeLabel. Apple Home may let the user
            replace this label during or after commissioning. Matter limits
            this value to 32 characters.

endmenu
```

## sdkconfig.defaults
```kconfig
CONFIG_ESPTOOLPY_FLASHSIZE_8MB=y

#enable BT
CONFIG_BT_ENABLED=y
CONFIG_BT_NIMBLE_ENABLED=y
CONFIG_BT_NIMBLE_ENABLE_CONN_REATTEMPT=n
CONFIG_USE_BLE_ONLY_FOR_COMMISSIONING=n

# Increase some stack size
CONFIG_ESP_SYSTEM_EVENT_TASK_STACK_SIZE=7200
CONFIG_ESP_MAIN_TASK_STACK_SIZE=7200
CONFIG_ESP_TIMER_TASK_STACK_SIZE=5120
CONFIG_THREAD_TASK_STACK_SIZE=8192
CONFIG_CHIP_TASK_STACK_SIZE=10240

# partition table
CONFIG_PARTITION_TABLE_CUSTOM=y
CONFIG_PARTITION_TABLE_CUSTOM_FILENAME="partitions.csv"

# USB console for Thread border board
CONFIG_ESP_CONSOLE_USB_SERIAL_JTAG=y

# Use the Sub-Ethernet daughter board as backbone.
CONFIG_ENABLE_WIFI_STATION=n
CONFIG_WIFI_NETWORK_COMMISSIONING_DRIVER=n
CONFIG_ENABLE_ETHERNET_TELEMETRY=n
CONFIG_ETHERNET_NETWORK_COMMISSIONING_DRIVER=n
CONFIG_ETH_USE_SPI_ETHERNET=y
CONFIG_CUSTOM_NETWORK_CONFIG=n

# Disable SoftAP
CONFIG_ESP_WIFI_SOFTAP_SUPPORT=n

# LWIP
CONFIG_LWIP_IPV6_FORWARD=y
CONFIG_LWIP_IPV6_AUTOCONFIG=y
CONFIG_LWIP_IPV6_NUM_ADDRESSES=12
CONFIG_LWIP_MULTICAST_PING=y
CONFIG_LWIP_NETIF_STATUS_CALLBACK=y
CONFIG_LWIP_HOOK_IP6_ROUTE_DEFAULT=y
CONFIG_LWIP_HOOK_ND6_GET_GW_DEFAULT=y
CONFIG_LWIP_HOOK_IP6_INPUT_CUSTOM=y
CONFIG_LWIP_HOOK_IP6_SELECT_SRC_ADDR_CUSTOM=y

# Matter operational CASE must be reachable over Thread before BR backbone starts.
CONFIG_ENABLE_ROUTE_HOOK=y

# mbedTLS
CONFIG_MBEDTLS_KEY_EXCHANGE_ECJPAKE=y
CONFIG_MBEDTLS_SSL_PROTO_DTLS=y
CONFIG_MBEDTLS_ECJPAKE_C=y
CONFIG_MBEDTLS_HKDF_C=y

# OpenThread
CONFIG_OPENTHREAD_ENABLED=y
CONFIG_OPENTHREAD_LOG_LEVEL_DYNAMIC=n
CONFIG_OPENTHREAD_LOG_LEVEL_NOTE=y
CONFIG_OPENTHREAD_SRP_CLIENT=y
CONFIG_OPENTHREAD_DNS_CLIENT=y
CONFIG_OPENTHREAD_BORDER_ROUTER=y
CONFIG_OPENTHREAD_COMMISSIONER=y
CONFIG_OPENTHREAD_JOINER=y
CONFIG_OPENTHREAD_RADIO_SPINEL_UART=y
CONFIG_THREAD_NETWORK_COMMISSIONING_DRIVER=y
CONFIG_AUTO_UPDATE_RCP=y

# Official ESP Thread Border Router Web GUI and REST API
CONFIG_OPENTHREAD_BR_START_WEB=y
CONFIG_HTTPD_MAX_REQ_HDR_LEN=1024

#Enable chip shell
CONFIG_ENABLE_CHIP_SHELL=y

# Matter OTA
CONFIG_ENABLE_OTA_REQUESTOR=n

# Use platform mDNS
CONFIG_USE_MINIMAL_MDNS=n
CONFIG_ENABLE_EXTENDED_DISCOVERY=y

# Match proven Matter-over-Thread accessory timing.
CONFIG_ENABLE_PERSIST_SUBSCRIPTIONS=n
CONFIG_MRP_LOCAL_ACTIVE_RETRY_INTERVAL_FOR_THREAD=5000
CONFIG_MRP_LOCAL_IDLE_RETRY_INTERVAL_FOR_THREAD=5000
CONFIG_MRP_RETRY_INTERVAL_SENDER_BOOST_FOR_THREAD=5000
CONFIG_MRP_MAX_RETRANS=3

# This example only use 2 dynamic endpoints
CONFIG_ESP_MATTER_MAX_DYNAMIC_ENDPOINT_COUNT=2

# Use SPIRAM and external alloc
CONFIG_SPIRAM=y
CONFIG_SPIRAM_SPEED_80M=y
CONFIG_SPIRAM_MODE_QUAD=y
CONFIG_SPIRAM_MALLOC_ALWAYSINTERNAL=512
CONFIG_SPIRAM_MALLOC_RESERVE_INTERNAL=16384
CONFIG_SPIRAM_ALLOW_BSS_SEG_EXTERNAL_MEMORY=y
CONFIG_SPIRAM_TRY_ALLOCATE_WIFI_LWIP=y
CONFIG_BT_NIMBLE_MEM_ALLOC_MODE_EXTERNAL=y
CONFIG_ESP_MATTER_MEM_ALLOC_MODE_EXTERNAL=y
CONFIG_MBEDTLS_EXTERNAL_MEM_ALLOC=y

# disable groupcast cluster until verified
CONFIG_SUPPORT_GROUPCAST_CLUSTER=n
CONFIG_SUPPORT_WIFI_NETWORK_DIAGNOSTICS_CLUSTER=n
CONFIG_SUPPORT_WIFI_NETWORK_MANAGEMENT_CLUSTER=n
```
